## software/app/Kconfig
```kconfig
menu "Zephyr"
source "Kconfig.zephyr"
endmenu

module = segment_controller
module-str = "Seven-segment display controller"
source "subsys/logging/Kconfig.template.log_config"
```

## software/app/boards/others/segment_controller/Kconfig.segment_controller
```kconfig
# Copyright (c) 2023 Espressif Systems (Shanghai) Co., Ltd.
# SPDX-License-Identifier: Apache-2.0

config BOARD_SEGMENT_CONTROLLER
	select SOC_ESP32_WROOM_32UE_N4
	select SOC_ESP32_PROCPU if BOARD_SEGMENT_CONTROLLER_ESP32_PROCPU
	select SOC_ESP32_APPCPU if BOARD_SEGMENT_CONTROLLER_ESP32_APPCPU
```

## software/app/boards/others/segment_controller/board.yml
```yaml
board:
  name: segment_controller
  full_name: Seven-segment-controller
  vendor: other
  socs:
  - name: esp32
```
